## config/boards/shields/settings_reset /Kconfig.defconfig
```kconfig
if SHIELD_SETTINGS_RESET

config ZMK_SETTINGS_RESET_ON_START
    default y

endif
```

## config/boards/shields/tibiboard30 /Kconfig.shield
```kconfig
    config SHIELD_TIBIBOARD30_LEFT
    def_bool $(shields_list_contains,tibiboard30_left)

config SHIELD_TIBIBOARD30_RIGHT
    def_bool $(shields_list_contains,tibiboard30_right)
    
```

## config/boards/shields/tibiboard30/Kconfig.defconfig
```kconfig
if SHIELD_TIBIBOARD30_LEFT

config ZMK_KEYBOARD_NAME
    default "tibiboard30"

config ZMK_SPLIT_ROLE_CENTRAL
    default y

endif

if SHIELD_TIBIBOARD30_LEFT || SHIELD_TIBIBOARD30_RIGHT

config ZMK_SPLIT
    default y

endif
```

## config/west.yml
```yaml
manifest:
  remotes:
    - name: zmkfirmware
      url-base: https://github.com/zmkfirmware
  projects:
    - name: zmk
      remote: zmkfirmware
     
      revision: ac7f75b
      import: app/west.yml
  self:
    path: config
```
