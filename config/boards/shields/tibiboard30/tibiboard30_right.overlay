/* tibiboard30_right.overlay - Ver 3.2 改 (Sleep Fix) */
#include "tibiboard30.dtsi"

&transform {
    col-offset = <5>;
};

&kscan {
    compatible = "zmk,kscan-gpio-matrix";
    diode-direction = "col2row";

    /* ★右側もこれを入れないと起きない！ */
    wakeup-source;

    /* 行 (Rows) */
    row-gpios
        = <&xiao_d 7 (GPIO_ACTIVE_HIGH | GPIO_PULL_DOWN)>
        , <&xiao_d 8 (GPIO_ACTIVE_HIGH | GPIO_PULL_DOWN)>
        , <&xiao_d 9 (GPIO_ACTIVE_HIGH | GPIO_PULL_DOWN)>
        ;

    /* 列 (Cols) */
    col-gpios
        = <&xiao_d 6 GPIO_ACTIVE_HIGH>
        , <&xiao_d 5 GPIO_ACTIVE_HIGH>
        , <&xiao_d 4 GPIO_ACTIVE_HIGH>
        , <&xiao_d 3 GPIO_ACTIVE_HIGH>
        , <&xiao_d 2 GPIO_ACTIVE_HIGH>
        ;
};
